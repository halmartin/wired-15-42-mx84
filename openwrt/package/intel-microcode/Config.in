## openwrt/package/intel-microcode/Config.in
```kconfig
config BR2_PACKAGE_INTELMICROCODE
    prompt "intel-microcode.......................... Intel x86 CPU microcode"
    tristate
    default n if CONFIG_DEVEL
    help
      This package contains microcode updates for Intel x86 cpus.
```

## openwrt/package/iucode-tool/Config.in
```kconfig
config BR2_PACKAGE_IUCODETOOL
    prompt "iucode-tool.......................... Linux IUCODE TOOL"
    tristate
    default n if CONFIG_DEVEL
    help
      iucode-tool is a program to manipulate microcode update
      collections for Intel i686 and X86-64 system processors, and
      prepare them for use by the Linux kernel.
```
